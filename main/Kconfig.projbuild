## main/Kconfig.projbuild
```kconfig
menu "Wifi Configuration"

    config ESP_WIFI_SSID
        string "WiFi SSID"
        default "myssid"
        help
            SSID (network name) for the example to connect to.

    config ESP_WIFI_PASSWORD
        string "WiFi Password"
        default "mypassword"
        help
            WiFi password (WPA or WPA2) for the example to use.

    config ESP_MAXIMUM_RETRY
        int "Maximum retry"
        default 5
        help
            Set the Maximum retry to avoid station reconnecting to the AP unlimited when the AP is really inexistent.
endmenu

menu "MQTT Configuration"

    config ESP_MQTT_BROKER
        string "MQTT Broker Url"
        default "mqtt://mqtt-server"
        help
            Url to MQTT Server

    config ESP_MQTT_USER
        string "MQTT User"
        default "mqtt-user"
        help
            MQTT user.

    config ESP_MQTT_PASSWORD
        string "MQTT Password"
        default "mqtt-password"
        help
            MQTT password.
endmenu

menu "Pulse Capture Configuration"

    config ESP_WAKEUP_PULSE_THRESHOLD
        int "Main Proc Wakeup Pulse Count"
        default "1000"
        help
            Pulse threshold to wakeup main processor and transmit data

    config ESP_WAKEUP_TIME_THRESHOLD
        int "Main Proc Wakeup time threshold in seconds"
        default "3600"
        help
            Main processor will be woken up every ESP_WAKEUP_TIME_THRESHOLD seconds and transmit data
    
    config ULP_WAKEUP_TIME_THRESHOLD
        int "ULP Proc Wakeup time threshold in microseconds"
        default "20000"
        help
            ULP Program runs every ULP_WAKEUP_TIME_THRESHOLD microseconds to poll pulses
    
    config ULP_PULSE_HIGH_THRESHOLD
        int "High threshold for ADC to trigger signal HIGH"
        default "1800"
        help
            ULP Program detects signal as HIGH if the ADC value reading above this limit
    
    config ULP_PULSE_LOW_THRESHOLD
        int "High threshold for ADC to trigger signal LOW"
        default "1600"
        help
            ULP Program detects signal as LOW if the ADC value reading below this limit
endmenu
```
